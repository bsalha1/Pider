## billy_pi/Config.in
```kconfig
menu "Billy Packages"
    source "$BR2_EXTERNAL_BILLY_PI_PATH/package/didact/Config.in"
    source "$BR2_EXTERNAL_BILLY_PI_PATH/package/libcamera-rpi/Config.in"
    source "$BR2_EXTERNAL_BILLY_PI_PATH/package/libcamera-rpi-apps/Config.in"
    source "$BR2_EXTERNAL_BILLY_PI_PATH/package/libpisp/Config.in"
endmenu
```

## billy_pi/billy_pi_defconfig
```kconfig
BR2_aarch64=y
BR2_cortex_a76_a55=y
BR2_ARM_FPU_VFPV4=y
BR2_ARM64_PAGE_SIZE_16K=y
BR2_TOOLCHAIN_BUILDROOT_CXX=y
BR2_TARGET_GENERIC_ROOT_PASSWD="soup"
BR2_SYSTEM_DHCP="eth0"
BR2_ROOTFS_OVERLAY="../billy_pi/overlay"
BR2_ROOTFS_POST_BUILD_SCRIPT="../billy_pi/post-build.sh"
BR2_ROOTFS_POST_IMAGE_SCRIPT="../billy_pi/post-image.sh"
BR2_LINUX_KERNEL=y
BR2_LINUX_KERNEL_CUSTOM_VERSION=y
BR2_LINUX_KERNEL_CUSTOM_VERSION_VALUE="custom"
BR2_LINUX_KERNEL_USE_CUSTOM_CONFIG=y
BR2_LINUX_KERNEL_CUSTOM_CONFIG_FILE="../billy_pi/billy_pi_linux_defconfig"
BR2_LINUX_KERNEL_DTS_SUPPORT=y
BR2_LINUX_KERNEL_INTREE_DTS_NAME="broadcom/bcm2712-rpi-5-b"
BR2_LINUX_KERNEL_NEEDS_HOST_OPENSSL=y
BR2_PACKAGE_RPI_FIRMWARE=y
BR2_PACKAGE_RPI_FIRMWARE_CONFIG_FILE="../billy_pi/config.txt"
BR2_PACKAGE_RPI_FIRMWARE_CMDLINE_FILE="../billy_pi/cmdline.txt"
BR2_PACKAGE_OPENSSH=y
BR2_TARGET_ROOTFS_EXT2=y
BR2_TARGET_ROOTFS_EXT2_4=y
BR2_TARGET_ROOTFS_EXT2_SIZE="120M"
# BR2_TARGET_ROOTFS_TAR is not set
BR2_PACKAGE_HOST_DOSFSTOOLS=y
BR2_PACKAGE_HOST_GENIMAGE=y
BR2_PACKAGE_HOST_MTOOLS=y
```

## billy_pi/package/didact/Config.in
```kconfig
config BR2_PACKAGE_DIDACT
    bool "didact"
    help
        Didact is a super cool guy who will answer any question you have.
```

## pider/Config.in
```kconfig
menu "Pider Packages"
    source "$BR2_EXTERNAL_PIDER_PATH/package/libcamera-rpi/Config.in"
    source "$BR2_EXTERNAL_PIDER_PATH/package/libcamera-rpi-apps/Config.in"
    source "$BR2_EXTERNAL_PIDER_PATH/package/libpisp/Config.in"
    source "$BR2_EXTERNAL_PIDER_PATH/package/pider-init/Config.in"
endmenu
```

## pider/configs/pider_defconfig
```kconfig
BR2_aarch64=y
BR2_cortex_a76_a55=y
BR2_ARM_FPU_VFPV4=y
BR2_ARM64_PAGE_SIZE_16K=y
BR2_PACKAGE_HOST_LINUX_HEADERS_CUSTOM_6_11=y
BR2_TOOLCHAIN_BUILDROOT_CXX=y
BR2_PACKAGE_OVERRIDE_FILE="$(BR2_EXTERNAL_PIDER_PATH)/../override.mk"
BR2_PER_PACKAGE_DIRECTORIES=y
BR2_TARGET_GENERIC_HOSTNAME="pider"
BR2_TARGET_GENERIC_ISSUE="Pider Raspberry Pi 5"
BR2_INIT_NONE=y
BR2_ROOTFS_DEVICE_TABLE="$(BR2_EXTERNAL_PIDER_PATH)/boards/pider/device_table.txt"
BR2_TARGET_GENERIC_ROOT_PASSWD="soup"
BR2_ROOTFS_OVERLAY="$(BR2_EXTERNAL_PIDER_PATH)/boards/pider/overlay"
BR2_ROOTFS_POST_IMAGE_SCRIPT="$(BR2_EXTERNAL_PIDER_PATH)/boards/pider/post-image.sh"
BR2_LINUX_KERNEL=y
BR2_LINUX_KERNEL_CUSTOM_VERSION=y
BR2_LINUX_KERNEL_CUSTOM_VERSION_VALUE="custom"
BR2_LINUX_KERNEL_USE_CUSTOM_CONFIG=y
BR2_LINUX_KERNEL_CUSTOM_CONFIG_FILE="$(BR2_EXTERNAL_PIDER_PATH)/boards/pider/pider_linux_defconfig"
BR2_LINUX_KERNEL_DTS_SUPPORT=y
BR2_LINUX_KERNEL_INTREE_DTS_NAME="broadcom/bcm2712-rpi-5-b"
BR2_LINUX_KERNEL_NEEDS_HOST_OPENSSL=y
BR2_PACKAGE_BUSYBOX_CONFIG="$(BR2_EXTERNAL_PIDER_PATH)/boards/pider/pider_busybox_defconfig"
BR2_PACKAGE_BUSYBOX_SHOW_OTHERS=y
BR2_PACKAGE_FFMPEG=y
BR2_PACKAGE_FFMPEG_GPL=y
BR2_PACKAGE_BROTLI=y
BR2_PACKAGE_ZSTD=y
BR2_PACKAGE_BRCMFMAC_SDIO_FIRMWARE_RPI=y
BR2_PACKAGE_BRCMFMAC_SDIO_FIRMWARE_RPI_BT=y
BR2_PACKAGE_BRCMFMAC_SDIO_FIRMWARE_RPI_WIFI=y
BR2_PACKAGE_RPI_FIRMWARE=y
BR2_PACKAGE_RPI_FIRMWARE_CONFIG_FILE="$(BR2_EXTERNAL_PIDER_PATH)/boards/pider/config.txt"
BR2_PACKAGE_RPI_FIRMWARE_CMDLINE_FILE="$(BR2_EXTERNAL_PIDER_PATH)/boards/pider/cmdline.txt"
BR2_PACKAGE_LIBDRM_VC4=y
BR2_PACKAGE_LIBV4L=y
BR2_PACKAGE_LIBV4L_UTILS=y
BR2_PACKAGE_X264=y
BR2_PACKAGE_LIBNL=y
BR2_PACKAGE_DHCP=y
BR2_PACKAGE_DHCP_CLIENT=y
BR2_PACKAGE_FCGIWRAP=y
# BR2_PACKAGE_IFUPDOWN_SCRIPTS is not set
BR2_PACKAGE_NFTABLES=y
BR2_PACKAGE_NGINX=y
BR2_PACKAGE_NGINX_HTTP_SSL_MODULE=y
BR2_PACKAGE_OPENSSH=y
BR2_PACKAGE_TCPDUMP=y
BR2_PACKAGE_WPA_SUPPLICANT=y
# BR2_PACKAGE_WPA_SUPPLICANT_NL80211 is not set
BR2_PACKAGE_WPA_SUPPLICANT_WEXT=y
BR2_PACKAGE_SYSKLOGD=y
BR2_PACKAGE_SYSKLOGD_LOGGER=y
BR2_TARGET_ROOTFS_CPIO=y
BR2_TARGET_ROOTFS_CPIO_GZIP=y
# BR2_TARGET_ROOTFS_TAR is not set
BR2_TARGET_ARM_TRUSTED_FIRMWARE=y
BR2_TARGET_ARM_TRUSTED_FIRMWARE_CUSTOM_VERSION=y
BR2_TARGET_ARM_TRUSTED_FIRMWARE_CUSTOM_VERSION_VALUE="custom"
BR2_TARGET_ARM_TRUSTED_FIRMWARE_PLATFORM="rpi5"
BR2_TARGET_ARM_TRUSTED_FIRMWARE_DEBUG=y
BR2_PACKAGE_HOST_DOSFSTOOLS=y
BR2_PACKAGE_HOST_E2FSPROGS=y
BR2_PACKAGE_HOST_GENIMAGE=y
BR2_PACKAGE_HOST_MTOOLS=y
BR2_PACKAGE_LIBCAMERA_RPI_APPS=y
BR2_PACKAGE_PIDER_INIT=y
```

## pider/package/libcamera-rpi/Config.in
```kconfig
config BR2_PACKAGE_LIBCAMERA_RPI_ARCH_SUPPORTS
	bool
	default y
	# Invalid packing size of ControlValue struct on m68k
	depends on !BR2_m68k

config BR2_PACKAGE_LIBCAMERA_RPI
	bool "libcamera-rpi"
	depends on BR2_PACKAGE_LIBCAMERA_RPI_ARCH_SUPPORTS
	depends on BR2_INSTALL_LIBSTDCPP
	depends on BR2_TOOLCHAIN_HAS_THREADS
	depends on BR2_TOOLCHAIN_GCC_AT_LEAST_8 # C++17
	depends on !BR2_STATIC_LIBS # gnutls
	depends on BR2_USE_WCHAR # gnutls
	select BR2_PACKAGE_GNUTLS
	select BR2_PACKAGE_LIBYAML
	select BR2_PACKAGE_LIBPISP
	help
	  libcamera provides a software stack to support
	  complex devices that need heavy hardware image
	  processing operations.

	  http://www.libcamera.org/

comment "libcamera needs a toolchain w/ C++, threads, wchar, dynamic library, gcc >= 8"
	depends on BR2_PACKAGE_LIBCAMERA_ARCH_SUPPORTS
	depends on !BR2_INSTALL_LIBSTDCPP || !BR2_TOOLCHAIN_HAS_THREADS || \
		!BR2_TOOLCHAIN_GCC_AT_LEAST_8 || BR2_STATIC_LIBS || !BR2_USE_WCHAR
```

## pider/package/libpisp/Config.in
```kconfig
config BR2_PACKAGE_LIBPISP
	bool "libpisp"
	select BR2_PACKAGE_JSON_FOR_MODERN_CPP
	help
	  Generates run-time configuration for the Raspberry Pi
	  ISP (PiSP).
```

## pider/package/pider-init/Config.in
```kconfig
config BR2_PACKAGE_PIDER_INIT
	bool "pider-init"
	help
	  Entry point for Pider runtime.
```
